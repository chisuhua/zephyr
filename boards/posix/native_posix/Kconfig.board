## boards/posix/native_posix/Kconfig.board
```kconfig
# SPDX-License-Identifier: Apache-2.0

config BOARD_NATIVE_POSIX_32BIT
	bool "Native POSIX for 32-bit host"
	depends on SOC_POSIX
	select BOARD_NATIVE_POSIX
	help
	  Will produce a console Linux process which can be executed natively
	  as a 32-bit executable.
	  It provides some minimal needed models:
	  An interrupt controller, timer (system tick), and redirects kernel prints to
	  stdout.

config BOARD_NATIVE_POSIX_64BIT
	bool "Native POSIX for 64-bit host"
	depends on SOC_POSIX
	select BOARD_NATIVE_POSIX
	select 64BIT
	help
	  Will produce a console Linux process which can be executed natively
	  as a 64-bit executable.
	  It provides some minimal needed models:
	  An interrupt controller, timer (system tick), and redirects kernel prints to
	  stdout.

config BOARD_NATIVE_POSIX_64BIT_GEM5
	bool "Native POSIX for 64-bit host in gem5"
	depends on SOC_POSIX
	select BOARD_NATIVE_POSIX
	select 64BIT
	select GEM5
	help
	  Will produce a console Linux process which can be executed natively
	  as a 64-bit executable. and run on gem5
	  It provides some minimal needed models:
	  An interrupt controller, timer (system tick), and redirects kernel prints to
	  stdout.
```

## boards/posix/native_posix/native_posix_64_gem5_defconfig
```kconfig
# SPDX-License-Identifier: Apache-2.0

CONFIG_SOC_POSIX=y
CONFIG_BOARD_NATIVE_POSIX_64BIT_GEM5=y
CONFIG_CONSOLE=y
CONFIG_SYS_CLOCK_HW_CYCLES_PER_SEC=1000000
#CONFIG_MULTITHREADING=n
```

## boards/riscv/ppu32/Kconfig.board
```kconfig
# SPDX-License-Identifier: Apache-2.0

config BOARD_PPU32
	bool "PPU32 target"
	#depends on SOC_RISCV_SIFIVE_FREEDOM
	depends on SOC_RISCV32_PPU
```

## boards/riscv/ppu32/Kconfig.defconfig
```kconfig
# SPDX-License-Identifier: Apache-2.0


config BOARD
	default "ppu32"
	depends on BOARD_PPU32
```

## boards/riscv/ppu32/ppu32_defconfig
```kconfig
# SPDX-License-Identifier: Apache-2.0

CONFIG_SOC_SERIES_RISCV32_PPU=y
CONFIG_SOC_RISCV32_PPU=y
CONFIG_BOARD_PPU32=y
CONFIG_CONSOLE=y
CONFIG_SERIAL=y
CONFIG_PRINTK=y
CONFIG_UART_NS16550=y
#CONFIG_UART_PPU=y
CONFIG_UART_CONSOLE=y
CONFIG_PLIC=n
CONFIG_RISCV_MACHINE_TIMER=y
CONFIG_GPIO=n
CONFIG_XIP=y
CONFIG_SYS_CLOCK_TICKS_PER_SEC=10000000
CONFIG_MULTITHREADING=n
```

## drivers/serial/Kconfig.ppu
```kconfig
# Mi-V UART configuration option

# Copyright (c) 2018 Antmicro <www.antmicro.com>
# SPDX-License-Identifier: Apache-2.0

config UART_PPU
	bool "PPU serial driver"
	depends on SOC_RISCV32_PPU
	select SERIAL_HAS_DRIVER
	help
	  This option enables the Mi-V serial driver.
```

## soc/riscv/riscv-privilege/ppu/Kconfig.series
```kconfig
# RISCV32_PPU implementation

# Copyright (c) 2018 Antmicro <www.antmicro.com>
# SPDX-License-Identifier: Apache-2.0

config SOC_SERIES_RISCV32_PPU
	bool "Microsemi Mi-V implementation"
	select RISCV
	select SOC_FAMILY_RISCV_PRIVILEGE
	help
	  Enable support for Microsemi Mi-V
```

## soc/riscv/riscv-privilege/ppu/Kconfig.soc
```kconfig
# RISCV32_PPU configuration options

# Copyright (c) 2018 Antmicro <www.antmicro.com>
# SPDX-License-Identifier: Apache-2.0

choice
	prompt "Microsemi Mi-V system implementation"
	depends on SOC_SERIES_RISCV32_PPU

config SOC_RISCV32_PPU
	bool "Microsemi Mi-V system implementation"
	select ATOMIC_OPERATIONS_C

endchoice
```
